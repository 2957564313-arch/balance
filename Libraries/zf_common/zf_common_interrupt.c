#include "zf_common_interrupt.h"



//-------------------------------------------------------------------------------------------------------------------

// 函数简介     指定中断设置优先级

// 参数说明     irqn            指定中断号 可查看 zf_common_interrupt.h 对应中断服务函数的标注

// 参数说明     priority        抢占式优先级 0到3，0为最低优先级，3为最高优先级

// 返回参数     void

// 使用示例     interrupt_set_priority(	TIMER0_IRQn, 3);

//                              		设置周期中断定时器0的优先级为3

//                              		禁止调用ch32v30x_misc里面的函数

// 备注信息				 其余不能设置的，中断优先级全部为最低优先级0

//-------------------------------------------------------------------------------------------------------------------

void interrupt_set_priority (irqn_type_enum irqn, uint8 priority)

{

	if((irqn >> 4) == 0)

	{

		IP  |= (priority & 0x01) << (irqn & 0x0F);

		IPH |= ((priority >> 1) & 0x01) << (irqn & 0x0F);

	}

	else if((irqn >> 4) == 1)

	{

		IP2  |= (priority & 0x01) << (irqn & 0x0F);

		IP2H |= ((priority >> 1) & 0x01) << (irqn & 0x0F);

	}

	else if((irqn >> 4) == 2)

	{

//		IP3  |= (priority & 0x01) << (irqn & 0x0F);

//		IP3H |= ((priority >> 1) & 0x01) << (irqn & 0x0F);

	}

}



//-------------------------------------------------------------------------------------------------------------------

// 函数简介     关闭全局中断

// 参数说明     void            

// 返回参数     void

// 使用示例     

//             

// 备注信息				 

//-------------------------------------------------------------------------------------------------------------------

void interrupt_global_disable(void)

{

    EA = 0;

}



//-------------------------------------------------------------------------------------------------------------------

// 函数简介     开启全局中断

// 参数说明     void            

// 返回参数     void

// 使用示例     

//             

// 备注信息				 

//-------------------------------------------------------------------------------------------------------------------

void interrupt_global_enable(void)

{

    EA = 1;

}



